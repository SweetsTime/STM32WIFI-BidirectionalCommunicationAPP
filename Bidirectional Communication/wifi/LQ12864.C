#include "stm32f10x_rcc.h"
#include "stm32f10x_gpio.h"

#include "LQ12864.h"
#include <string.h>

#define high 1
#define low 0

//带参宏，可以像内联函数一样使用
#define OLED_SCL(a)	if (a)	\
					GPIO_SetBits(GPIOB, GPIO_Pin_6);\
					else		\
					GPIO_ResetBits(GPIOB,GPIO_Pin_6)

#define OLED_SDA(a)	if (a)	\
					GPIO_SetBits(GPIOB,GPIO_Pin_7);\
					else		\
					GPIO_ResetBits(GPIOB,GPIO_Pin_7)

                                          
#define NOPS  asm("NOP");asm("NOP");asm("NOP");asm("NOP");asm("NOP");

#define	Brightness	0xCF 
#define X_WIDTH 	128
#define Y_WIDTH 	64
                                          
                                          
                                          
static const char  F8X16[]=	  

{
  0x00,0x00,0x00,0x00,0x00,0x00,0x00,0x00,0x00,0x00,0x00,0x00,0x00,0x00,0x00,0x00,// 0
  0x00,0x00,0x00,0xF8,0x00,0x00,0x00,0x00,0x00,0x00,0x00,0x33,0x30,0x00,0x00,0x00,//! 1
  0x00,0x10,0x0C,0x06,0x10,0x0C,0x06,0x00,0x00,0x00,0x00,0x00,0x00,0x00,0x00,0x00,//" 2
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  0x00,0x06,0x01,0x01,0x02,0x02,0x04,0x04,0x00,0x00,0x00,0x00,0x00,0x00,0x00,0x00,//~ 94
};

/*********************OLED驱动程序用的延时程序************************************/
void OLED_delay(unsigned int z)
{
  unsigned int x;
  for(x=z;x>0;x--)
    NOPS;
}

/**********************************************
//IIC Start
**********************************************/
void OLED_IIC_Start(void)
{
  OLED_SCL( high);		
  OLED_SDA (high);
  NOPS;
  OLED_SDA (low);
  OLED_SCL ( low);
  NOPS;
}

/**********************************************
//IIC Stop
**********************************************/
void OLED_IIC_Stop(void)
{
  OLED_SCL ( low);
  OLED_SDA ( low);
  NOPS;
  OLED_SCL( high);
  OLED_SDA ( high);
  NOPS;
}

/**********************************************
// IIC Write byte
**********************************************/
void Write_IIC_Byte(unsigned char IIC_Byte)
{
  unsigned char i;
  for(i=0;i<8;i++)
  {
    if(IIC_Byte & 0x80)
      OLED_SDA(high);
    else
      OLED_SDA(low);
    OLED_SCL( high);
    NOPS;
    OLED_SCL(low);
    IIC_Byte<<=1;
    NOPS;
  }
  OLED_SDA(high);
  OLED_SCL( high);
  NOPS;
  OLED_SCL(low);
  NOPS;
}

/*********************OLED写数据************************************/ 
void OLED_WrDat(unsigned char IIC_Data)	 
{
  OLED_IIC_Start();
  Write_IIC_Byte(0x78);
  Write_IIC_Byte(0x40);			//write data
  Write_IIC_Byte(IIC_Data);
  OLED_IIC_Stop();
}

/*********************OLED写命令************************************/
void OLED_WrCmd(unsigned char IIC_Command)
{
  OLED_IIC_Start();
  Write_IIC_Byte(0x78);            //Slave address,SA0=0
  Write_IIC_Byte(0x00);			//write command
  Write_IIC_Byte(IIC_Command);
  OLED_IIC_Stop();
}

/*********************OLED 设置坐标************************************/
void OLED_Set_Pos(unsigned char x, unsigned char y) 
{ 
  OLED_WrCmd(0xb0+y);
  OLED_WrCmd(((x&0xf0)>>4)|0x10);
  OLED_WrCmd((x&0x0f));
} 

/*********************OLED全屏************************************/
void OLED_Fill(unsigned char bmp_dat) 
{
  unsigned char y,x;
  for(y=0;y<8;y++)
  {
    OLED_WrCmd(0xb0+y);
    OLED_WrCmd(0x01);
    OLED_WrCmd(0x10);
    for(x=0;x<X_WIDTH;x++)
      OLED_WrDat(bmp_dat);
  }
}

//////////////////////////////////////////////
//////OLED多行清屏函数  参数为需要清屏的行号///
/////行号用二进制的方式表示
/*      eg:0x01    第1行   0x02     第2行   0x04   第3行     0x08  第4行
0X03     第1行和第二行
0X07     第1、2、3行
*/
//////////////////////////////////////////
void OLED_Clear_Line(uint8_t LineNum)
{
  char temp[16]={"                "};
  
  if((LineNum & OLED_Line_1) == OLED_Line_1)
    OLED_P8x16StrLen(0,0,temp,16);
  
  if((LineNum & OLED_Line_2) == OLED_Line_2)
    OLED_P8x16StrLen(0,2,temp,16);
  
  if((LineNum & OLED_Line_3) == OLED_Line_3)
    OLED_P8x16StrLen(0,4,temp,16);
  
  if((LineNum & OLED_Line_4 )== OLED_Line_4)
    OLED_P8x16StrLen(0,6,temp,16);
  
}


/*********************OLED复位************************************/
void OLED_CLS(void)
{
  unsigned char y,x;
  for(y=0;y<8;y++)
  {
    OLED_WrCmd(0xb0+y);
    OLED_WrCmd(0x01);
    OLED_WrCmd(0x10);
    for(x=0;x<X_WIDTH;x++)
      OLED_WrDat(0);
  }
}

/*********************OLED初始化************************************/
void OLED_Init(void)
{       
  IIC_GPIO_Config();
  OLED_delay(500);//初始化之前的延时很重要！
  OLED_WrCmd(0xae);//--turn off oled panel
  OLED_WrCmd(0x00);//---set low column address
  OLED_WrCmd(0x10);//---set high column address
  OLED_WrCmd(0x40);//--set start line address  Set Mapping RAM Display Start Line (0x00~0x3F)
  OLED_WrCmd(0x81);//--set contrast control register
  OLED_WrCmd(Brightness); // Set SEG Output Current Brightness
  OLED_WrCmd(0xa1);//--Set SEG/Column Mapping     0xa0左右反置 0xa1正常
  OLED_WrCmd(0xc8);//Set COM/Row Scan Direction   0xc0上下反置 0xc8正常
  OLED_WrCmd(0xa6);//--set normal display
  OLED_WrCmd(0xa8);//--set multiplex ratio(1 to 64)
  OLED_WrCmd(0x3f);//--1/64 duty
  OLED_WrCmd(0xd3);//-set display offset	Shift Mapping RAM Counter (0x00~0x3F)
  OLED_WrCmd(0x00);//-not offset
  OLED_WrCmd(0xd5);//--set display clock divide ratio/oscillator frequency
  OLED_WrCmd(0x80);//--set divide ratio, Set Clock as 100 Frames/Sec
  OLED_WrCmd(0xd9);//--set pre-charge period
  OLED_WrCmd(0xf1);//Set Pre-Charge as 15 Clocks & Discharge as 1 Clock
  OLED_WrCmd(0xda);//--set com pins hardware configuration
  OLED_WrCmd(0x12);
  OLED_WrCmd(0xdb);//--set vcomh
  OLED_WrCmd(0x40);//Set VCOM Deselect Level
  OLED_WrCmd(0x20);//-Set Page Addressing Mode (0x00/0x01/0x02)
  OLED_WrCmd(0x02);//
  OLED_WrCmd(0x8d);//--set Charge Pump enable/disable
  OLED_WrCmd(0x14);//--set(0x10) disable
  OLED_WrCmd(0xa4);// Disable Entire Display On (0xa4/0xa5)
  OLED_WrCmd(0xa6);// Disable Inverse Display On (0xa6/a7) 
  OLED_WrCmd(0xaf);//--turn on oled panel
  OLED_Fill(0x00); //初始清屏
  OLED_Set_Pos(0,0);
} 

/*******************功能描述：显示8*16一组标准ASCII字符串	 显示的坐标（x,y），y为页范围0～7****************/
void OLED_P8x16Str(unsigned char x,unsigned char y,char ch[])
{
  unsigned char c=0,i=0,j=0;
  while (ch[j]!='\0')
  {
    c =ch[j]-32;
    if(x>120 && y < 5){x=0;y+=2;}
    OLED_Set_Pos(x,y);
    for(i=0;i<8;i++)
      OLED_WrDat(F8X16[c*16+i]);
    OLED_Set_Pos(x,y+1);
    for(i=0;i<8;i++)
      OLED_WrDat(F8X16[c*16+i+8]);
    x+=8;
    j++;
  }
}

/***************功能描述：显示指定长度的标准ASCII字符串，1个字符所用像素点为8*16，len为字符串长度*************/
void OLED_P8x16StrLen(unsigned char x,unsigned char y,char ch[],unsigned char len)
{
  unsigned char c=0,i=0,j=0;
  while (len)
  {
    c =ch[j]-32;
    if(x>120 && y < 5){x=0;y+=2;}
    OLED_Set_Pos(x,y);
    for(i=0;i<8;i++)
      OLED_WrDat(F8X16[c*16+i]);
    OLED_Set_Pos(x,y+1);
    for(i=0;i<8;i++)
      OLED_WrDat(F8X16[c*16+i+8]);
    x+=8;
    j++;
    len--;
  }
}

//////////////////////////////////////
//////OLED显示函数////////////
/*   
显示的时候，如果字符串长度超过16位 自动换行，最多64位
line： 行号       
str: 需要打印的字符串(注意：str 最多不能超过64位)
*/

//////////////////////////////

void OLED_Display(uint8_t line,char *str)
{
  uint8_t Line_Temp;
  uint8_t Str_Length=0,count,i;
  uint8_t Str_Error=0 ,Line_Error=0;
  
  
  switch (line)
  {
  case OLED_Line_1:
    Line_Temp = 0;
    break;
    
  case OLED_Line_2:
    Line_Temp = 2;
    break;
    
  case OLED_Line_3:  
    Line_Temp = 4;
    break;
    
  case OLED_Line_4:  
    Line_Temp = 6;
    break;
    
  default:
    
    OLED_P8x16StrLen(0,1, "Input Line Error",16);
    Line_Error=1;
    goto out;
    break;
    
  }
  
  Str_Length=strlen(str);
  
  if(Str_Length <= 16 && Str_Length > 0)
  {
    OLED_P8x16StrLen(0,Line_Temp, str, Str_Length);
  }
  
  else if(Str_Length >16 && Str_Length <= (16 * 4))
  {
    count=Str_Length/16;
    
    for(i=0;i<count;i++)
    {
      OLED_P8x16StrLen(0,Line_Temp, &str[i*16], 16);
      Line_Temp+=2;
    }
    
    OLED_P8x16StrLen(0,Line_Temp, &str[i*16],Str_Length%16 );
    
  }
  
  else
  {
    OLED_P8x16StrLen(0,2, "Input Str Error!",16);
    Str_Error = 1;
    goto out;
  }
  
out:
  if(Str_Error == 1)
    OLED_P8x16StrLen(0,4, "Check Str Length",16);
  
  if(Line_Error == 1)
    OLED_P8x16StrLen(0,4, "Check Line Num!",15);
  
  
}

void IIC_GPIO_Config(void)
{		
  /*定义一个GPIO_InitTypeDef类型的结构体*/
  GPIO_InitTypeDef GPIO_InitStructure;
  
  /*开启GPIOC的外设时钟*/
  RCC_APB2PeriphClockCmd( RCC_APB2Periph_GPIOB, ENABLE); 
  
  /*选择要控制的GPIOC引脚*/															   
  GPIO_InitStructure.GPIO_Pin = GPIO_Pin_6 | GPIO_Pin_7;	
  
  /*设置引脚模式为通用推挽输出*/
  GPIO_InitStructure.GPIO_Mode = GPIO_Mode_Out_PP;   
  
  /*设置引脚速率为50MHz */   
  GPIO_InitStructure.GPIO_Speed  = GPIO_Speed_50MHz; 
  
  /*调用库函数，初始化GPIOC*/
  GPIO_Init(GPIOB, &GPIO_InitStructure);		  
  
  /* 关闭所有led灯	*/
  GPIO_SetBits(GPIOB, GPIO_Pin_6 | GPIO_Pin_7);	 
}

void OLED_itoa(unsigned char x,unsigned char y,unsigned char *puls)
{   
  unsigned char i=0,j=0;
  unsigned char tan[2];
  
  
  tan[0]=*puls/16;
  tan[1]=*puls&0x0f;
  
  if(tan[0]<=0x09)
  {
    tan[0]=tan[0]+16;
  }
  else
  {
    tan[0]=tan[0]+23;
  }
  
  if(tan[1]<=0x09)
  {
    tan[1]=tan[1]+16;
  }
  else
  { 
    tan[1]=tan[1]+23;
  }
  
  if(x>120){x=0;y++;}
  
  OLED_Set_Pos(x,y);
  for(i=0;i<8;i++)
    OLED_WrDat(F8X16[tan[0]*16+i]);
  OLED_Set_Pos(x,y+1);
  for(i=0;i<8;i++)
    OLED_WrDat(F8X16[tan[0]*16+i+8]);
  x+=8;
  
  OLED_Set_Pos(x,y);
  for(i=0;i<8;i++)
    OLED_WrDat(F8X16[tan[1]*16+i]);
  OLED_Set_Pos(x,y+1);
  for(i=0;i<8;i++)
    OLED_WrDat(F8X16[tan[1]*16+i+8]);
  x+=8;
  j++;
  
}
